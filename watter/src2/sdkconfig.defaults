## watter/src2/sdkconfig.defaults
```kconfig
# Включаем стек Zigbee и задаём роль устройства
CONFIG_ESP_ZB_ENABLE=y
CONFIG_ESP_ZB_DEVICE_TYPE_ZED=y
CONFIG_ESP_ZB_DEVICE_TYPE_ZR=n
CONFIG_ESP_ZB_DEVICE_TYPE_ZC=n
CONFIG_ESP_ZB_RADIO_USE_NATIVE=y
CONFIG_ESP_ZB_RADIO_UART=n
CONFIG_ESP_ZB_FLASH_NVRAM_ENABLED=y
```
